## meta-ledge-sw/conf/layer.conf
```bitbake
# We might have a conf and classes directory, append to BBPATH
BBPATH .= ":${LAYERDIR}"

# We have a recipes directory, add to BBFILES
BBFILES += "${LAYERDIR}/recipes*/*/*.bb ${LAYERDIR}/recipes*/*/*.bbappend"

BBFILE_COLLECTIONS += "meta-ledge-sw"
BBFILE_PATTERN_meta-ledge-sw := "^${LAYERDIR}/"
BBFILE_PRIORITY_meta-ledge-sw = "30"

# This should only be incremented on significant changes that will
# cause compatibility issues with other layers
LAYERVERSION_meta-ledge-sw = "1"
LAYERSERIES_COMPAT_meta-ledge-sw= "hardknott"

# enable selinux
DISTRO_FEATURES_append = "acl xattr pam selinux"
PACKAGECONFIG_pn-sudo = "pam-wheel"

# set permissive mode for now. We can change this to enforcing once we have the
# proper policy installed
#DEFAULT_ENFORCING = "enforcing"
DEFAULT_ENFORCING = "permissive"
PREFERRED_PROVIDER_virtual/refpolicy = "refpolicy-mls"

# enable EFI
DISTRO_FEATURES_append = " efi"

# enable udisks2 (for clevis)
DISTRO_FEATURES_append = " polkit"

#k3s
DISTRO_FEATURES_append = " seccomp"
```

## meta-ledge-sw/conf/machine/ledge-synquacer.conf
```bitbake
require conf/machine/include/arm/arch-arm64.inc

MACHINE_ENDIANNESS ?= "le"

# Define specific familly common machine name
MACHINEOVERRIDES .= ":ledgecommon"

PREFERRED_PROVIDER_virtual/kernel = "linux-ledge"
PREFERRED_VERSION_linux-ledge = "mainline%"
INITRAMFS_IMAGE = "ledge-initramfs"
WKS_FILE_DEPENDS += "ledge-initramfs"
do_image_wic[depends] += "ledge-initramfs:do_image_complete"

PACKAGECONFIG_pn_mesa = "${@bb.utils.filter('DISTRO_FEATURES', 'wayland ', d)} \
                   ${@bb.utils.contains('DISTRO_FEATURES', 'opengl', 'opengl egl gles gbm dri', '', d)} \
                   ${@bb.utils.contains('DISTRO_FEATURES', 'x11 opengl', 'x11', '', d)} \
                   ${@bb.utils.contains('DISTRO_FEATURES', 'x11 vulkan', 'dri3', '', d)} \
                   gallium"

MACHINE_EXTRA_RDEPENDS += " \
    edk2-efi-prebuild-fw \
    "
KERNEL_IMAGETYPE = "Image"

SERIAL_CONSOLE = "115200 ttyMV0"

MACHINE_FEATURES = "ext2 ipsec nfs pci smbfs usbgadget usbhost vfat"
```

## meta-ledge-sw/recipes-samples/images/wic/ledge-qemuarm64-efi-image.wks
```
#part /boot --source bootimg-partition --ondisk mmcblk --fstype=vfat --label boot --active --align 4096 --size 16
#
part /boot --source bootimg-efi-arm --sourceparams="loader=kernel-uefi" --ondisk mmcblk --fstype=vfat --label boot --align 4096 --size 16
#part / --source rootfs --rootfs-dir=boot --ondisk mmcblk --fstype=vfat --label boot --align 4096 --size 16
part / --source rootfs --ondisk mmcblk --fstype=ext4 --label root --align 4096
bootloader --ptable msdos
```

## meta-lite-bsp/conf/layer.conf
```bitbake
# We might have a conf and classes directory, append to BBPATH
BBPATH .= ":${LAYERDIR}"

# We have a recipes directory, add to BBFILES
BBFILES += "${LAYERDIR}/recipes*/*/*.bb ${LAYERDIR}/recipes*/*/*.bbappend"

BBFILE_COLLECTIONS += "meta-lite-bsp"
BBFILE_PATTERN_meta-lite-bsp := "^${LAYERDIR}/"
BBFILE_PRIORITY_meta-lite-bsp = "9"

# add dependency to meta-freescale-3rdparty for cubox-i machine
LAYERDEPENDS_meta-lite-bsp = "fsl-arm-extra"


EULA_FILE_FREESCALE = "${LAYERDIR}/conf/eula/${MACHINE}"
```

## meta-lite-bsp/conf/machine/lite-hummingboard2.conf
```bitbake
require conf/machine/cubox-i.conf

PREFERRED_PROVIDER_virtual/kernel = "linux-lite"
PREFERRED_VERSION_linux-lite = "4.14%"

KERNEL_DEVICETREE = " imx6q-hummingboard2-som-v15.dtb "
IMAGE_INSTALL_append = " hummingboard-btattach "

MACHINE_EXTRA_RRECOMMENDS_remove = "bcm4330-nvram-config bcm4329-nvram-config"

ACCEPT_FSL_EULA = "${ACCEPT_EULA_lite-hummingboard2}"

# Hack for GPU: do not use imx-gpu-viv
PREFERRED_PROVIDER_virtual/egl_lite-hummingboard2 = "mesa"
PREFERRED_PROVIDER_virtual/libgles1_lite-hummingboard2 = "mesa"
PREFERRED_PROVIDER_virtual/libgles2_lite-hummingboard2 = "mesa"
PREFERRED_PROVIDER_virtual/mesa_lite-hummingboard2 = "mesa"
PREFERRED_PROVIDER_virtual/libgl_lite-hummingboard2 = "mesa"

PACKAGECONFIG_pn_mesa = "${@bb.utils.filter('DISTRO_FEATURES', 'wayland ', d)} \
                   ${@bb.utils.contains('DISTRO_FEATURES', 'opengl', 'opengl egl gles gbm dri', '', d)} \
                   ${@bb.utils.contains('DISTRO_FEATURES', 'x11 opengl', 'x11', '', d)} \
                   ${@bb.utils.contains('DISTRO_FEATURES', 'x11 vulkan', 'dri3', '', d)} \
                   \
                   etnaviv \
                   gallium \
        "

MACHINEOVERRIDES_EXTENDER_mx6q  = ""
MACHINEOVERRIDES_EXTENDER_mx6dl  = ""
MACHINE_EXTRA_RRECOMMENDS_remove_mx6q = " ${@bb.utils.contains('DISTRO_FEATURES', 'alsa', 'imx-alsa-plugins', '', d)} "
MACHINE_EXTRA_RRECOMMENDS_remove_mx6dl = " ${@bb.utils.contains('DISTRO_FEATURES', 'alsa', 'imx-alsa-plugins', '', d)} "
```

## meta-lite-gw/conf/distro/lite-gw.conf
```bitbake
DISTRO_NAME = "Lite Gateway (A Yocto Project Based Distro)"
DISTRO_VERSION = "2.4"
DISTRO_CODENAME = "rocko"

# These default to 'oecore' and 'nodistro'
SDK_NAME_PREFIX = "${DISTRO}"
SDK_VERSION = "${DISTRO_VERSION}"

TARGET_VENDOR = "-linaro"

# defaultsetup.inc gets includes after ${DISTRO}.conf, so we need to set it here
# to make the python below work. Local, site and auto.conf will override it.
TCMODE ?= "default"

# TODO: is that really want we want?
IMAGE_LINGUAS = "en-gb"

# =========================================================================
# DISTRO features
# =========================================================================
DISTRO_FEATURES  = "alsa"
DISTRO_FEATURES += "argp"
DISTRO_FEATURES += "ext2"
DISTRO_FEATURES += "ext4"
DISTRO_FEATURES += "largefile"
DISTRO_FEATURES += "ipv4"
DISTRO_FEATURES += "ipv6"
DISTRO_FEATURES += "multiarch"
DISTRO_FEATURES += "wifi"
DISTRO_FEATURES += "nfs"
DISTRO_FEATURES += "usbgadget"
DISTRO_FEATURES += "usbhost"
DISTRO_FEATURES += "xattr"
DISTRO_FEATURES += "zeroconf"
DISTRO_FEATURES += "bluetooth"
DISTRO_FEATURES += "bluez5"
DISTRO_FEATURES += "${DISTRO_FEATURES_LIBC}"

# add support of gstreamer
DISTRO_FEATURES_append = " gstreamer "

# add support of wayland
DISTRO_FEATURES_append = " wayland pam "

# add support of X11
#DISTRO_FEATURES_append = " x11"

# add support of systemd
DISTRO_FEATURES_append = " systemd "

# Disabling sysvinit
DISTRO_FEATURES_BACKFILL_CONSIDERED += "sysvinit"

VIRTUAL-RUNTIME_init_manager = "systemd"
VIRTUAL-RUNTIME_initscripts = "systemd-compat-units"

# opengl
DISTRO_FEATURES_append = " opengl "

# for docker / virtualization
#DISTRO_FEATURES_append = " virtualization "
# =========================================================================
# PACKAGE CONFIG
# =========================================================================
PACKAGECONFIG_append_pn-systemd = " resolved networkd "
PACKAGECONFIG_append_pn-qtbase = " gles2 fontconfig examples"
PACKAGECONFIG_remove_pn-gpsd = "qt"
PACKAGECONFIG_append_pn-gstreamer1.0-plugins-bad = " kms"

# =========================================================================
# LICENSE FLAGS
# =========================================================================
LICENSE_FLAGS_WHITELIST += "commercial_gstreamer1.0-libav commercial_ffmpeg commercial_x264 non-commercial"

# =========================================================================
# LOCAL / IMAGE configuration
# =========================================================================
# Set GLIBC_GENERATE_LOCALES to the locales you wish to generate should you not
# wish to perform the time-consuming step of generating all LIBC locales.
# NOTE: If removing en_US.UTF-8 you will also need to uncomment, and set
# appropriate value for IMAGE_LINGUAS.
# WARNING: this may break localisation!
GLIBC_GENERATE_LOCALES = "en_GB.UTF-8 en_US.UTF-8"
IMAGE_LINGUAS ?= "en-gb"

# Support of devshell
INHERIT += "devshell"

# Remove the old image before the new one generated to save disk space
RM_OLD_IMAGE = "1"

# Nice debug data
INHERIT += "buildhistory"
BUILDHISTORY_COMMIT = "1"
INHERIT += "image-buildinfo"


# Clean up working directory after build
INHERIT += "rm_work"

# force the usage of debian package
#PACKAGE_CLASSES = "package_deb"

# Avoid to duplicate the rootfs tarball by generating both tar.gz/tar.xz
IMAGE_FSTYPES_remove = "tar.gz"
```
