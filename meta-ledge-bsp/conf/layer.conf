## meta-ledge-bsp/conf/layer.conf
```bitbake
# We might have a conf and classes directory, append to BBPATH
BBPATH .= ":${LAYERDIR}"

# We have a recipes directory, add to BBFILES
BBFILES += "${LAYERDIR}/recipes*/*/*.bb ${LAYERDIR}/recipes*/*/*.bbappend"

BBFILE_COLLECTIONS += "meta-ledge-bsp"
BBFILE_PATTERN_meta-ledge-bsp := "^${LAYERDIR}/"
BBFILE_PRIORITY_meta-ledge-bsp = "9"

# add dependency to meta-freescale-3rdparty for cubox-i machine
LAYERDEPENDS_meta-ledge-bsp = "fsl-arm-extra"

EULA_FILE_FREESCALE = "${LAYERDIR}/conf/eula/${MACHINE}"

# This should only be incremented on significant changes that will
# cause compatibility issues with other layers
LAYERVERSION_meta-ledge-bsp = "1"
LAYERSERIES_COMPAT_meta-ledge-bsp = "sumo thud zeus"
```

## meta-ledge-bsp/conf/machine/include/ledge-qemu-common.inc
```bitbake
QB_TAP_OPT = "-netdev tap,id=net0,ifname=@TAP@,script=no,downscript=no"
QB_NETWORK_DEVICE = "-device virtio-net-pci,netdev=net0,mac=@MAC@"
QB_ROOTFS_OPT = "-drive id=disk0,file=@ROOTFS@,if=none,format=raw -device virtio-blk-device,drive=disk0"
QB_MEM = "-m 4096"
# add 20GB space for VM
IMAGE_ROOTFS_EXTRA_SPACE = "20971520"
```

## meta-ledge-bsp/conf/machine/ledge-espressobin.conf
```bitbake
require conf/machine/include/arm/arch-arm64.inc

MACHINE_ENDIANNESS ?= "le"

PREFERRED_PROVIDER_virtual/kernel = "linux-ledge"
PREFERRED_VERSION_linux-ledge = "mainline%"

PACKAGECONFIG_pn_mesa = "${@bb.utils.filter('DISTRO_FEATURES', 'wayland ', d)} \
                   ${@bb.utils.contains('DISTRO_FEATURES', 'opengl', 'opengl egl gles gbm dri', '', d)} \
                   ${@bb.utils.contains('DISTRO_FEATURES', 'x11 opengl', 'x11', '', d)} \
                   ${@bb.utils.contains('DISTRO_FEATURES', 'x11 vulkan', 'dri3', '', d)} \
                   gallium"

KERNEL_IMAGETYPE = "Image"
KERNEL_DEVICETREE = "marvell/armada-3720-espressobin.dtb"

SERIAL_CONSOLE = "115200 ttyMV0"
ARM_TRUSTED_FIRMWARE_PLATFORM = "a3700"

MACHINE_FEATURES = "ext2 ipsec nfs pci smbfs usbgadget usbhost vfat"
```

## meta-ledge-bsp/conf/machine/ledge-qemuarm.conf
```bitbake
#@TYPE: Machine
#@NAME: generic armv7a machine
#@DESCRIPTION: Machine configuration for running a generic armv7

require conf/machine/include/arm/arch-armv7a.inc
require conf/machine/include/ledge-qemu-common.inc

OPTEEMACHINE = "vexpress-qemu_virt"
OPTEEOUTPUTMACHINE = "vexpress"

MACHINE_FEATURES += "optee"
MACHINE_FEATURES += "tpm2"
MACHINE_FEATURES += "ftpm"

PREFERRED_PROVIDER_virtual/bootloader = "u-boot-ledge"
UBOOT_CONFIG = "basic"
UBOOT_DEVICETREE = "qemu_arm.dtb"
UBOOT_CONFIG[basic]   = "ledge-qemuarm_defconfig,,u-boot.bin"
EXTRA_IMAGEDEPENDS_append = " virtual/bootloader "

MACHINE_EXTRA_RDEPENDS += " \
    optee-os \
    trusted-firmware-a-ledge \
    edk2-efi-prebuild-fw \
    "
```

## meta-ledge-bsp/conf/machine/ledge-qemuarm64.conf
```bitbake
#@TYPE: Machine
#@NAME: generic armv8 machine
#@DESCRIPTION: Machine configuration for running a generic armv8

require conf/machine/include/arm/arch-armv8a.inc
require conf/machine/include/qemu.inc

OPTEEMACHINE = "vexpress-qemu_armv8a"
OPTEEOUTPUTMACHINE = "vexpress"

MACHINE_FEATURES += "optee"
MACHINE_FEATURES += "tpm2"
MACHINE_FEATURES += "ftpm"

PREFERRED_PROVIDER_virtual/bootloader = "u-boot-ledge"
UBOOT_CONFIG = "basic"
UBOOT_DEVICETREE = "qemu_arm64.dtb"
UBOOT_CONFIG[basic]   = "ledge-qemuarm64_defconfig,,u-boot.bin"
EXTRA_IMAGEDEPENDS_append = " virtual/bootloader"

MACHINE_EXTRA_RDEPENDS += " \
    optee-os \
    trusted-firmware-a-ledge \
    edk2-efi-prebuild-fw \
    "
```

## meta-ledge-bsp/conf/machine/ledge-qemux86-64.conf
```bitbake
#@TYPE: Machine
#@NAME: common_pc
#@DESCRIPTION: Machine configuration for running a common x86

# Define specific familly common machine name
MACHINEOVERRIDES .= ":ledgecommon"

require conf/machine/include/qemu.inc
DEFAULTTUNE ?= "core2-64"
require conf/machine/include/tune-core2.inc
require conf/machine/include/qemuboot-x86.inc

UBOOT_MACHINE ?= "qemu-x86_64_defconfig"

SERIAL_CONSOLES ?= "115200;ttyS0 115200;ttyS1"


MACHINE_FEATURES += "x86 pci"
MACHINE_FEATURES += "pcbios efi"

MACHINE_ESSENTIAL_EXTRA_RDEPENDS += "v86d"

MACHINE_EXTRA_RDEPENDS += " \
    edk2-efi-prebuild-fw \
    "
```

## meta-ledge-bsp/conf/machine/ledge-stm32mp157c-dk2.conf
```bitbake
include conf/machine/include/tune-cortexa7.inc

DEFAULTTUNE = "cortexa7thf-neon-vfpv4"

KERNEL_DEVICETREE = "stm32mp157c-dk2.dtb"
SERIAL_CONSOLE = "115200 ttySTM0"

MACHINE_FEATURES += "tsn"
MACHINE_FEATURES += "optee"
MACHINE_FEATURES += "tpm2"
MACHINE_FEATURES += "ftpm"

PREFERRED_PROVIDER_virtual/bootloader = "u-boot-ledge"
UBOOT_CONFIG = "trusted"
# Define u-boot defconfig and binary to use for each UBOOT_CONFIG
UBOOT_CONFIG[trusted] = "ledge_stm32mp157c_dk2_trusted_defconfig,,u-boot.stm32"

MACHINE_EXTRA_RDEPENDS += " \
    optee-os \
    trusted-firmware-a-ledge \
    virtual/bootloader \
    edk2-efi-prebuild-fw \
    "
```

## meta-ledge-bsp/conf/machine/ledge-synquacer.conf
```bitbake
require conf/machine/include/arm/arch-arm64.inc

MACHINE_ENDIANNESS ?= "le"

MACHINE_EXTRA_RDEPENDS += " \
    edk2-efi-prebuild-fw \
    "

SERIAL_CONSOLE = "115200 ttyMV0"
```

## meta-ledge-bsp/conf/machine/ledge-ti-am572x.conf
```bitbake
require conf/machine/am57xx-evm.conf

KERNEL_DEVICETREE = "am572x-idk.dtb"

PREFERRED_PROVIDER_virtual/bootloader = "u-boot-ledge"
PREFERRED_PROVIDER_u-boot = "u-boot-ledge"
unset UBOOT_MACHINE
UBOOT_CONFIG = "trusted"
UBOOT_CONFIG[trusted] = "ledge-ti-am572x_defconfig,,u-boot.img"
EXTRA_IMAGEDEPENDS_remove = "u-boot"

MACHINE_EXTRA_RRECOMMENDS = "prueth-fw"
MACHINE_FEATURES += "tsn"

MACHINE_EXTRA_RDEPENDS += " \
    edk2-efi-prebuild-fw \
    "

RDEPENDS_${KERNEL_PACKAGE_NAME}-base_append_ledge-ti-am572x = " prueth-fw"
FILES_${KERNEL_PACKAGE_NAME}-devicetree_append_ledge-ti-am572x += "/${KERNEL_IMAGEDEST}/*.itb"
```

## meta-ledge-bsp/recipes-bsp/u-boot/u-boot-ledge/ledge-stm32mp157c-dk2/ledge_stm32mp157c_dk2_trusted_defconfig
```kconfig
CONFIG_ARM=y
CONFIG_ARCH_STM32MP=y
CONFIG_SYS_MALLOC_F_LEN=0x3000
CONFIG_TARGET_STM32MP1=y
CONFIG_STM32MP1_OPTEE=y
CONFIG_DISTRO_DEFAULTS=y
CONFIG_FIT=y
CONFIG_USE_BOOTARGS=y
CONFIG_BOOTARGS="console=ttySTM0,115200 rootwait root=PARTLABEL=rootfs efi=novamap,noruntime selinux=0"
CONFIG_BOOTCOMMAND="run bootcmd_stm32mp"
CONFIG_SYS_PROMPT="STM32MP> "
# CONFIG_CMD_BOOTD is not set
# CONFIG_CMD_ELF is not set
# CONFIG_CMD_IMI is not set
# CONFIG_CMD_XIMG is not set
# CONFIG_CMD_EXPORTENV is not set
# CONFIG_CMD_IMPORTENV is not set
CONFIG_CMD_MEMINFO=y
CONFIG_CMD_MEMTEST=y
CONFIG_CMD_ADC=y
CONFIG_CMD_CLK=y
CONFIG_CMD_DFU=y
CONFIG_CMD_FUSE=y
CONFIG_CMD_GPIO=y
CONFIG_CMD_GPT=y
CONFIG_CMD_I2C=y
CONFIG_CMD_MMC=y
CONFIG_CMD_USB=y
CONFIG_CMD_USB_MASS_STORAGE=y
CONFIG_CMD_CACHE=y
CONFIG_CMD_TIME=y
CONFIG_CMD_TIMER=y
CONFIG_CMD_PMIC=y
CONFIG_CMD_REGULATOR=y
CONFIG_CMD_EXT4_WRITE=y
CONFIG_DEFAULT_DEVICE_TREE="stm32mp157c-dk2"
CONFIG_ENV_IS_NOWHERE=y
# CONFIG_ENV_IS_IN_EXT4=y
# CONFIG_ENV_EXT4_INTERFACE="mmc"
# CONFIG_ENV_EXT4_DEVICE_AND_PART="0:auto"
# CONFIG_ENV_EXT4_FILE="/uboot.env"
CONFIG_STM32_ADC=y
CONFIG_USB_FUNCTION_FASTBOOT=y
CONFIG_FASTBOOT_BUF_ADDR=0xC0000000
CONFIG_FASTBOOT_BUF_SIZE=0x02000000
CONFIG_FASTBOOT_USB_DEV=1
CONFIG_FASTBOOT_FLASH=y
CONFIG_FASTBOOT_FLASH_MMC_DEV=1
CONFIG_DM_HWSPINLOCK=y
CONFIG_HWSPINLOCK_STM32=y
CONFIG_DM_I2C=y
CONFIG_SYS_I2C_STM32F7=y
CONFIG_LED=y
CONFIG_LED_GPIO=y
CONFIG_DM_MMC=y
CONFIG_SUPPORT_EMMC_BOOT=y
CONFIG_STM32_SDMMC2=y
CONFIG_DM_ETH=y
CONFIG_DWC_ETH_QOS=y
CONFIG_PHY=y
CONFIG_PHY=y
CONFIG_PHY_STM32_USBPHYC=y
CONFIG_PINCONF=y
CONFIG_PINCTRL_STMFX=y
CONFIG_DM_PMIC=y
CONFIG_PMIC_STPMIC1=y
CONFIG_DM_REGULATOR_FIXED=y
CONFIG_DM_REGULATOR_GPIO=y
CONFIG_DM_REGULATOR_STM32_VREFBUF=y
CONFIG_DM_REGULATOR_STPMIC1=y
CONFIG_SERIAL_RX_BUFFER=y
CONFIG_STM32_SERIAL=y
CONFIG_USB=y
CONFIG_DM_USB=y
CONFIG_DM_USB_GADGET=y
CONFIG_USB_EHCI_HCD=y
CONFIG_USB_EHCI_GENERIC=y
CONFIG_USB_GADGET=y
CONFIG_USB_GADGET_MANUFACTURER="STMicroelectronics"
CONFIG_USB_GADGET_VENDOR_NUM=0x0483
CONFIG_USB_GADGET_PRODUCT_NUM=0x5720
CONFIG_USB_GADGET_DWC2_OTG=y
CONFIG_DM_RTC=y
CONFIG_RTC_STM32=y
```

## meta-ledge-distro/conf/distro/ledge-distro.conf
```bitbake
require conf/distro/include/rpb.inc

DISTRO_NAME = "Reference-Platform-Build-for-LEDGE"

# no graphic by default
DISTRO_FEATURES_remove = "wayland x11"

# for docker / virtualization
DISTRO_FEATURES_append = " virtualization "

# =========================================================================
# LOCAL / IMAGE configuration
# =========================================================================
# Set GLIBC_GENERATE_LOCALES to the locales you wish to generate should you not
# wish to perform the time-consuming step of generating all LIBC locales.
# NOTE: If removing en_US.UTF-8 you will also need to uncomment, and set
# appropriate value for IMAGE_LINGUAS.
# WARNING: this may break localisation!
GLIBC_GENERATE_LOCALES = "en_GB.UTF-8 en_US.UTF-8"
IMAGE_LINGUAS ?= "en-gb"

# Remove the old image before the new one generated to save disk space
RM_OLD_IMAGE = "1"

# Clean up working directory after build
INHERIT += "rm_work"

# force the usage of debian package
#PACKAGE_CLASSES = "package_deb"

# =========================================================================
# OSTREE
# =========================================================================
# SOTA
#OSTREE_OSNAME = "ledge"
#OSTREE_INITRAMFS_IMAGE = "initramfs-ostree-ledge-image"
#INITRAMFS_IMAGE = "${OSTREE_INITRAMFS_IMAGE}"
OSTREE_INITRAMFS_FSTYPES = "cpio.gz"
#OSTREE_KERNEL_ARGS = "root=LABEL=otaroot rootfstype=ext4"
## No need to install the kernel image into the boot partition
#IMAGE_BOOT_FILES_remove_sota = " ${KERNEL_IMAGETYPE}"
## Runtime prov by default to allow runtime configuration
#SOTA_CLIENT_PROV ?= "aktualizr-runtime-prov"

# General
#WKS_FILE_DEPENDS_BOOTLOADERS_remove = "syslinux systemd-boot"
## We don't use the default efi sota wks file
#WKS_FILE_sota_remove = "efiimage-sota.wks"
```

## meta-ledge-distro/conf/layer.conf
```bitbake
# We might have a conf and classes directory, append to BBPATH
BBPATH .= ":${LAYERDIR}"

# We have a recipes directory, add to BBFILES
BBFILES += "${LAYERDIR}/recipes*/*/*.bb ${LAYERDIR}/recipes*/*/*.bbappend"

BBFILE_COLLECTIONS += "meta-ledge-distro"
BBFILE_PATTERN_meta-ledge-distro := "^${LAYERDIR}/"
BBFILE_PRIORITY_meta-ledge-distro = "9"

LAYERDEPENDS_meta-ledge-distro = "meta-rpb"

# This should only be incremented on significant changes that will
# cause compatibility issues with other layers
LAYERVERSION_meta-ledge-distro = "1"
LAYERSERIES_COMPAT_meta-ledge-distro= "sumo"
```

## meta-ledge-gw/conf/distro/ledge-gw.conf
```bitbake
DISTRO_NAME = "Ledge Gateway (A Yocto Project Based Distro)"
DISTRO_VERSION = "2.5"
DISTRO_CODENAME = "sumo"

# These default to 'oecore' and 'nodistro'
SDK_NAME_PREFIX = "${DISTRO}"
SDK_VERSION = "${DISTRO_VERSION}"

TARGET_VENDOR = "-linaro"

# defaultsetup.inc gets includes after ${DISTRO}.conf, so we need to set it here
# to make the python below work. Local, site and auto.conf will override it.
TCMODE ?= "default"
TCLIBCAPPEND = ""

# TODO: is that really want we want?
IMAGE_LINGUAS = "en-gb"

# =========================================================================
# DISTRO features
# =========================================================================
DISTRO_FEATURES_append = " alsa "
DISTRO_FEATURES_append = " argp "
DISTRO_FEATURES_append = " ext4 "
DISTRO_FEATURES_append = " largefile "
DISTRO_FEATURES_append = " ipv4 "
DISTRO_FEATURES_append = " ipv6 "
DISTRO_FEATURES_append = " wifi "
DISTRO_FEATURES_append = " bluetooth "
DISTRO_FEATURES_append = " bluez5 "
DISTRO_FEATURES_append = " usrmerge "
DISTRO_FEATURES_append = " pam "

DISTRO_FEATURES_remove = "3g irda pcmcia nfc sysvinit"

# add support of gstreamer
DISTRO_FEATURES_append = " gstreamer "

# add support of wayland
#DISTRO_FEATURES_append = " wayland "

# add support of X11
#DISTRO_FEATURES_append = " x11"
# No need for x11 even for native
DISTRO_FEATURES_NATIVE_remove = "x11"
DISTRO_FEATURES_NATIVESDK_remove = "x11"

# add support of systemd
DISTRO_FEATURES_append = " systemd "
VIRTUAL-RUNTIME_init_manager = "systemd"
VIRTUAL-RUNTIME_initscripts = "systemd-compat-units"

# Disabling sysvinit
DISTRO_FEATURES_BACKFILL_CONSIDERED += "sysvinit"

# opengl
DISTRO_FEATURES_append = " opengl "

# for docker / virtualization
DISTRO_FEATURES_append = " virtualization "
# =========================================================================
# PACKAGE CONFIG
# =========================================================================
PACKAGECONFIG_append_pn-systemd = " resolved networkd "
PACKAGECONFIG_append_pn-qtbase = " gles2 fontconfig examples"
PACKAGECONFIG_remove_pn-gpsd = "qt"
PACKAGECONFIG_append_pn-gstreamer1.0-plugins-bad = " kms"
PACKAGECONFIG_append_pn-qemu-native = " libusb"

# =========================================================================
# LICENSE FLAGS
# =========================================================================
LICENSE_FLAGS_WHITELIST += "commercial_gstreamer1.0-libav commercial_ffmpeg commercial_x264 non-commercial"

# =========================================================================
# LOCAL / IMAGE configuration
# =========================================================================
# Set GLIBC_GENERATE_LOCALES to the locales you wish to generate should you not
# wish to perform the time-consuming step of generating all LIBC locales.
# NOTE: If removing en_US.UTF-8 you will also need to uncomment, and set
# appropriate value for IMAGE_LINGUAS.
# WARNING: this may break localisation!
GLIBC_GENERATE_LOCALES = "en_GB.UTF-8 en_US.UTF-8"
IMAGE_LINGUAS ?= "en-gb"

# Support of devshell
INHERIT += "devshell"

# Remove the old image before the new one generated to save disk space
RM_OLD_IMAGE = "1"

# Nice debug data
INHERIT += "buildhistory"
BUILDHISTORY_COMMIT = "1"
INHERIT += "image-buildinfo"


# Clean up working directory after build
INHERIT += "rm_work"

# force the usage of debian package
#PACKAGE_CLASSES = "package_deb"

# Avoid to duplicate the rootfs tarball by generating both tar.gz/tar.xz
IMAGE_FSTYPES_remove = "tar.gz"



# =========================================================================
# Coming from osf
# =========================================================================
OSF_LMP_GIT_URL="github.com"
OSF_LMP_GIT_NAMESPACE="OpenSourceFoundries/"

#PREFERRED_PROVIDER_virtual/kernel = "linux-osf"
PREFERRED_PROVIDER_iasl-native = "acpica-native"

# LMP default classes and overwrites
INHERIT += "lmp"

# SOTA
OSTREE_OSNAME = "lmp"
OSTREE_INITRAMFS_IMAGE = "initramfs-ostree-osf-image"
INITRAMFS_IMAGE = "${OSTREE_INITRAMFS_IMAGE}"
OSTREE_INITRAMFS_FSTYPES = "cpio.gz"
OSTREE_KERNEL_ARGS = "root=LABEL=otaroot rootfstype=ext4"
## No need to install the kernel image into the boot partition
IMAGE_BOOT_FILES_remove_sota = " ${KERNEL_IMAGETYPE}"
## Runtime prov by default to allow runtime configuration
SOTA_CLIENT_PROV ?= "aktualizr-runtime-prov"

# General
WKS_FILE_DEPENDS_BOOTLOADERS_remove = "syslinux systemd-boot"
## We don't use the default efi sota wks file
WKS_FILE_sota_remove = "efiimage-sota.wks"
```

## meta-ledge-gw/conf/layer.conf
```bitbake
# We might have a conf and classes directory, append to BBPATH
BBPATH .= ":${LAYERDIR}"

# We have a recipes directory, add to BBFILES
BBFILES += "${LAYERDIR}/recipes*/*/*.bb ${LAYERDIR}/recipes*/*/*.bbappend"

BBFILE_COLLECTIONS += "meta-ledge-gw"
BBFILE_PATTERN_meta-ledge-gw := "^${LAYERDIR}/"
BBFILE_PRIORITY_meta-ledge-gw = "9"

# This should only be incremented on significant changes that will
# cause compatibility issues with other layers
LAYERVERSION_meta-ledge-gw = "1"
LAYERSERIES_COMPAT_meta-ledge-gw = "sumo"
```
